// RingTheBell 2025
// Author: https://github.com/Mark-MDO47/
//

/*
   Copyright 2025 Mark Olson

   Licensed under the Apache License, Version 2.0 (the "License");
   you may not use this file except in compliance with the License.
   You may obtain a copy of the License at

       http://www.apache.org/licenses/LICENSE-2.0

   Unless required by applicable law or agreed to in writing, software
   distributed under the License is distributed on an "AS IS" BASIS,
   WITHOUT WARRANTIES OR CONDITIONS OF ANY KIND, either express or implied.
   See the License for the specific language governing permissions and
   limitations under the License.
 */


// This can be updated via an "OTA:WEB" ESP-NOW command, which will cause us to open a web page
//   on the specified SSID allowing Over-The-Air software update. That capability is based on
//   the ESP32 example OTAWebUpdater.ino

// connections:
//
// YX5200/DFPlayer Sound Player
//   ESP32 Dev Module pin D-16   DPIN_HWSRL_RX   Arduino RX; YX5200 TX - 9600 Baud
//   ESP32 Dev Module pin D-17   DPIN_HWSRL_TX   Arduino TX; YX5200 RX - 9600 Baud
//   ESP32 Dev Module pin D-23   DPIN_AUDIO_BUSY YX5200 BUSY; HIGH when audio finishes
//

// Attributions for the sounds are on the MicroSD card containing the sounds.
// The sounds are either obtained from https://freesound.org/ or else generated by me using Audacity https://www.audacityteam.org/


// See https://github.com/Mark-MDO47/AudioPlayer-YX5200 for details on using the YX5200/DFPlayer.
//   I usually install a copy of the DFRobot.com DFPlayer code when using it, since I did a lot
//   of debugging to find how to use it on all the variants of the YX5200 I have seen.
//   The still unmodified DFRobot.com DFPlayer code files are DFRobotDFPlayerMini.*.
//   LICENSE_for_DFRobot_code.txt shows it is OK to do this and describes the legal boundaries
//   for correct usage.

#include "Arduino.h"                // general Arduino definitions plus uint8_t etc.

// mdo_use_ota_webupdater https://github.com/Mark-MDO47/UniRemote/tree/master/code/mdo_use_ota_webupdater
// This does not connect to WiFi router until it gets a command
#define MDO_USE_OTA 1               // zero to not use, non-zero to use OTA ESP32 Over-The-Air software updates

#if MDO_USE_OTA
#include "../lib_mdo_use_ota/mdo_use_ota_webupdater.h"   // for mdo_use_ota_webupdater "library"
#include "../lib_mdo_use_ota/mdo_use_ota_webupdater.cpp" // for mdo_use_ota_webupdater "library"
#endif // MDO_USE_OTA

#include "HardwareSerial.h"         // to talk with the YX5200 - ESP32 version uses hardware serial port

////////////////////////////////////////////////////////////////////////////////////////
// definitions for YX5200/DFPlayer

#define DPIN_HWSRL_RX   16  // HW-serial in  - talk to DFPlayer audio player (YX5200)
#define DPIN_HWSRL_TX   17  // HW-serial out - talk to DFPlayer audio player (YX5200)
#define DPIN_AUDIO_BUSY 23  // digital input - HIGH when audio finishes
#define SOUND_ACTIVE_PROTECT 200  // milliseconds to keep SW twiddled sound active after doing myDFPlayer.play(mySound)
uint32_t gTimerForceSoundActv = 0;  // SOUND_ACTIVE_PROTECT until millis() >= this

#include "SoundNum.h"               // numbers for each sound
uint16_t g_soundnum;

#include "../lib_DFPlayerMini/DFRobotDFPlayerMini.h"    // to communicate with the YX5200 audio player
#include "../lib_DFPlayerMini/DFRobotDFPlayerMini.cpp"  // to communicate with the YX5200 audio player
DFRobotDFPlayerMini myDFPlayer;                         // to talk to YX5200 audio player
void DFsetup();                                         // how to initialize myDFPlayer

#define SOUND_VOL_MIN      0   // range 0 to 30
#define SOUND_VOL_MAX      30  // range 0 to 30
#define SOUND_VOL_DEFAULT  25  // default volume - range 0 to 30

// #define DFPRINTDETAIL 1 // if need detailed status from myDFPlayer (YX5200 communications)
#define DFPRINTDETAIL 0  // will not print detailed status from myDFPlayer

#if DFPRINTDETAIL // routine to do detailed debugging
  void DFprintDetail(uint8_t type, int value); // definition of call
#else  // no DFPRINTDETAIL
  #define DFprintDetail(type, value) // nothing at all
#endif // #if DFPRINTDETAIL

#include "../lib_commonDFcode/lib_commonDFcode.h" // actually C-code routines
//   DFsetup(); - call from setup() routine
//   DFstartSound(uint16_t p_SoundNum, uint16_t p_Volume); - starts new sound even if currently playing a sound
//   DFcheckSoundDone(); - returns TRUE if current sound is complete
//   DFprintDetail(uint8_t type, int value); - optional routine to break out error code onto Serial

/////////////////////////////////////////////////////////////////////////////////////////////////////////
// do_ota() - Over-The-Air software update - ESP32 only
//       returns: 0 if no error
//
//   start OTA
//
uint16_t do_ota() {

#if MDO_USE_OTA // if using Over-The-Air software updates
  mdo_ota_web_request(START_OTA_WEB_BEGIN_WIFI | START_OTA_WEB_INIT_MDNS | START_OTA_WEB_INIT_UPDATER_WEBPAGE); // loop() will handle it
  Serial.printf("\nOTA Web Updater REQUESTED\n");
#endif // MDO_USE_OTA if using Over-The-Air software updates

  return(0);
} // end do_ota()

/////////////////////////////////////////////////////////////////////////////////////////////////////////
// setup()
void setup() {
  Serial.begin(115200);         // this serial communication is for general debug; set the USB serial port to 115,200 baud
  while (!Serial) {
    ; // wait for serial port to connect. Needed for native USB port only
  }
  delay(3000);
  Serial.println(""); // print a blank line in case there is some junk from power-on
  Serial.println("starting DuelWithBanjos");

#if VM_OTA_DEBUG
  // Connect to WiFi network
  WiFi.begin(g_ssid, g_password);
  Serial.println("");

  // Wait for connection
  while (WiFi.status() != WL_CONNECTED) {
    delay(500);
    Serial.print(".");
  }
  Serial.println("");
  Serial.print("Connected to ");
  Serial.println(g_ssid);
  Serial.print("IP address: ");
  Serial.println(WiFi.localIP());
#endif // VM_OTA_DEBUG

  // initialize the YX5200 DFPlayer audio player
  Serial.println("\nInitialize YX5200");
  DFsetup();

  Serial.println("\nRingTheBell_ESP32 init complete...");

  // start the first sound, then allow normal loop() processing
  g_soundnum = SOUNDNUM_silence;
  DFstartSound(g_soundnum, SOUND_VOL_DEFAULT);

  // we don't need any setup for mdo_use_ota_webupdater

} // end setup()

/////////////////////////////////////////////////////////////////////////////////////////////////////////
// loop()
//
void loop() {

  if (StartButtonPressed()) {
    DFstartSound(nextSoundnum(1), SOUND_VOL_DEFAULT); // force sequence start
  else if (FinishButtonPressed()) {
    DFstartSound(nextSoundnum(2), SOUND_VOL_DEFAULT); // force sequence finish
  } else if (DFcheckSoundDone()) {
    // next sound in sequence
    DFstartSound(nextSoundnum(0), SOUND_VOL_DEFAULT); // sequence to silence
  }

  if (OTAButtonPressed()) {
  }

#if MDO_USE_OTA // if using Over-The-Air software updates
  // if using Over-The-Air software updates
  mdo_ota_web_loop();
#endif // MDO_USE_OTA if using Over-The-Air software updates

  delay(50); // delay 50 milliseconds
} // end loop()
